## meta-recovery/conf/distro/rpi3-distro.conf
```bitbake
require conf/distro/poky.conf


DISTRO_FEATURES:remove ="bluetooth debuginfod pcmcia usbgadget usbhost wifi pci 3g nfc opengl ptest multiarch wayland vulkan pulseaudio gobject-introspection-data ldconfig"
```

## meta-recovery/conf/machine/rpi3-recovery.conf
```bitbake
require conf/machine/raspberrypi3-64.conf


MACHINEOVERRIDES .= ":raspberrypi3-64"

MACHINE_FEATURES:remove= "usbhost keyboard screen touchscreen bluetooth wifi qemu-usermode"

MACHINE_EXTRA_RRECOMMENDS:remove= "linux-firmware-rpidistro-bcm43430 linux-firmware-rpidistro-bcm43455 bluez-firmware-rpidistro-bcm43430a1-hcd bluez-firmware-rpidistro-bcm4345c0-hcd  kernel-modules udev-rules-rpi"


RPI_USE_U_BOOT = "1"
ENABLE_UART = "1"
PREFERRED_PROVIDER_virtual/bootloader = "u-boot"
INITRAMFS_IMAGE = "initramfs-recovery"
INITRAMFS_IMAGE_BUNDLE = "1"
BOOT_SPACE = "1073741"
INITRAMFS_MAXSIZE = "315400"
IMAGE_FSTYPES:pn-${INITRAMFS_IMAGE} = "${INITRAMFS_FSTYPES}"
```
